
/*------------------------------------------------------------------*/
/* --- STC MCU International Limited -------------------------------*/
/* --- STC 1T Series MCU Programme Demo ----------------------------*/
/* --- Fax: 86-755-82944243 ----------------------------------------*/
/* --- Tel: 86-755-82948412 ----------------------------------------*/
/* --- Web: www.STCMCU.com -----------------------------------------*/
/* If you want to use the program or the program referenced in the  */
/* article, please specify in which data and procedures from STC    */
/*------------------------------------------------------------------*/

/*      本程序经过测试完全正常, 不提供电话技术支持, 如不能理解, 请自行补充相关基础.  */


/*************	本程序功能说明	**************

用PCA实现n位PWM

**********************************************/



#include	"PWMn.h"

//========================================================================
// 文件: PWMn_main.c
// 功能: 测试模拟PWM的应用程序。
// 版本: VER1.0
// 日期: 2011-4-11
// 备注: 
//========================================================================

/*************	功能说明	**************

在PWMn.h中选择是STC12C5201AD系列还是STC12C5A60S2系列。
用PCA模拟的9~16bit的PWM。
STC12C5201AD系列从PCA0的P3.7输出PWM。
STC12C5A60S2系列从PCA0的P1.3输出PWM。
本示例程序使用Fosc=24.576MHZ. 输出6000HZ的12bit PWM。

******************************************/

/************ 工程文件
PWMn.c
PWMn_main.c
*****************/

/*************	本地常量声明	**************/


/*************	本地变量声明	**************/
unsigned int	pwm;		//定义用户操作的PWM变量

/*************	本地函数声明	**************/
void  delay_ms(unsigned char ms);



/****************  外部函数声明和外部变量声明 *****************/
extern unsigned int	PWM_high;			//PWM空比寄存器，即PWM输出高电平的PCA时钟脉冲个数（占空比写入变量）。
void PWMn_SetHighReg(unsigned int high);
void PWMn_init(unsigned int high);


/******************** 主函数 **************************/
//========================================================================
// 函数: void main(void)
// 描述: 不断更新PWM值，用示波器观察占空比变化。
// 参数: 无。
// 返回: 无。
// 版本: VER1.0
// 日期: 2011-4-11
// 备注: 
//========================================================================
void main(void)
{
	pwm = 1000;		//pwm初值
	pwm = PWM_HIGH_MIN;		//pwm初值
	PWMn_init(pwm);	//初始化pwm
	
	while (1)
	{
		delay_ms(10);	//延时
		pwm += 10;
		if(pwm >= PWM_HIGH_MAX)	pwm = PWM_HIGH_MIN;
		PWMn_SetHighReg(pwm);		//更新PWM的占空比
	}
}
/**********************************************/


//========================================================================
// 函数: void  delay_ms(unsigned char ms)
// 描述: 延时函数。
// 参数: ms,要延时的ms数.
// 返回: none.
// 版本: VER1.0
// 日期: 2010-12-15
// 备注: 
//========================================================================
void  delay_ms(unsigned char ms)
{
     unsigned int i;
	 do
	 {
		i = MAIN_Fosc / 14000L;	//1T
		while(--i)	;
     }while(--ms);
}

