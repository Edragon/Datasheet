
/*------------------------------------------------------------------*/
/* --- STC MCU International Limited -------------------------------*/
/* --- STC 1T Series MCU Programme Demo ----------------------------*/
/* --- Fax: 86-755-82944243 ----------------------------------------*/
/* --- Tel: 86-755-82948412 ----------------------------------------*/
/* --- Web: www.STCMCU.com -----------------------------------------*/
/* If you want to use the program or the program referenced in the  */
/* article, please specify in which data and procedures from STC    */
/*------------------------------------------------------------------*/

/*      本程序经过测试完全正常, 不提供电话技术支持, 如不能理解, 请自行补充相关基础.  */


/*************	本程序功能说明	**************

用位信息通知主程序, 避免主程序和中断程序操作同一个变量而出现不完整错误.

比如本例中,如果在主程序判断(counter == 500), 可能出现主程序刚刚判断完高字节就进入中断改变了counter,

退出中断后主程序再判断低字节, 出现错误.


******************************************/


#include	<reg51.h>

/*********************************************************/

//#define MAIN_Fosc		22118400L	//定义主时钟	串口0波特率600~115200
//#define MAIN_Fosc		33177600L	//定义主时钟	串口0波特率300~57600
//#define MAIN_Fosc		11059200L	//定义主时钟	串口0波特率300~57600
#define MAIN_Fosc		18432000L	//定义主时钟	串口0波特率600~19200
//#define MAIN_Fosc		24000000L	//定义主时钟	串口0波特率600~115200
//#define MAIN_Fosc		12000000L	//定义主时钟	串口0波特率300~4800

#define D_TIMER0		1000		//选择定时器0基准定时时间, us

/*********************************************************/


/**************************************************************************/

#define freq_base		(MAIN_Fosc / 1200)
#define Timer0_Reload	(D_TIMER0 * freq_base / 10000)

/***********************************************************/

#define	uchar	unsigned char
#define uint	unsigned int
#define ulong	unsigned long



/*************	本地常量声明	**************/


/*************	本地变量声明	**************/

uint	counter;
bit		B_500ms;		//0.5秒定时标志
sbit	P10 = P1^0;

/*************	本地函数声明	**************/
void	InitTimer0(void);



/*************  外部函数和变量声明 *****************/



/********************* 主函数 *************************/
void main(void)
{

	InitTimer0();

while(1)
	{
		if(B_500ms)	//1秒定时到
		{
			B_500ms = 0;
			P10 = ~P10;
		}
	}
} 
/**********************************************/




/**********************************************/
void InitTimer0(void)
{
	#if Timer0_Reload > 255
		TMOD = 0x01;
		TH0  = (65536 - Timer0_Reload) / 256;
		TL0  = (65536 - Timer0_Reload) % 256;
	#else
		TMOD = 0x02;
		TL0  = TH0 = 256 - Timer0_Reload;
	#endif

	ET0 = 1;
	TR0 = 1;
	EA  = 1;
}



/**********************************************/
void timer0 (void) interrupt 1
{
	#if Timer0_Reload > 255
		TH0  = (65536 - Timer0_Reload) / 256;
		TL0  = (65536 - Timer0_Reload) % 256;
	#endif
	
	if(counter >= 500)	//500ms计数
	{
		counter = 0;
		B_500ms = 1;	//500ms标志
	}

}

